## pocketbeagle_2/assets/boot.its
```
/dts-v1/;

/ {
	description = "PocketBeagle 2 Zephyr Boot";

	images {
		default = "script";

		script {
			data = /incbin/("./boot.txt");
			type = "script";
		};
	};
};
```
